## boards/shields/kaka/Kconfig.defconfig
```kconfig
if SHIELD_KAKA_LEFT

# Name must be less than 16 characters long!
config ZMK_KEYBOARD_NAME
    default "KAKA"

config ZMK_SPLIT_ROLE_CENTRAL
    default y

endif

if SHIELD_KAKA_LEFT || SHIELD_KAKA_RIGHT

config ZMK_SPLIT
    default y

endif
```

## boards/shields/kaka/Kconfig.shield
```kconfig
config SHIELD_KAKA_LEFT
    def_bool $(shields_list_contains,kaka_left)


# No whitespace after the comma or in your part name!
config SHIELD_KAKA_LEFT
    def_bool $(shields_list_contains,kaka_left)

# No whitespace after the comma or in your part name!
config SHIELD_KAKA_RIGHT
    def_bool $(shields_list_contains,kaka_right)
```
